## CMakeLists.txt
```
#
# Copyright (c) 2026 Nordic Semiconductor ASA
#
# SPDX-License-Identifier: LicenseRef-Nordic-5-Clause
#
cmake_minimum_required(VERSION 3.20.0)

find_package(Zephyr REQUIRED HINTS $ENV{ZEPHYR_BASE})
project(fp_provision)

# Decode the base64 Anti-Spoofing key at build time into a C header, so no
# base64 decoding is done on the device during provisioning.
set(fp_prov_gen_dir ${CMAKE_CURRENT_BINARY_DIR}/gen)
set(fp_prov_key_header ${fp_prov_gen_dir}/fp_provision_key.h)

add_custom_command(
  OUTPUT ${fp_prov_key_header}
  COMMAND ${CMAKE_COMMAND} -E make_directory ${fp_prov_gen_dir}
  COMMAND ${PYTHON_EXECUTABLE}
          ${CMAKE_CURRENT_SOURCE_DIR}/fp_provision_key_gen.py
          --key "${CONFIG_FP_PROVISION_ANTI_SPOOFING_KEY}"
          --output ${fp_prov_key_header}
  DEPENDS ${CMAKE_CURRENT_SOURCE_DIR}/fp_provision_key_gen.py
  COMMENT "Fast Pair: decoding Anti-Spoofing key into ${fp_prov_key_header}"
  VERBATIM
)
add_custom_target(fp_provision_key_gen DEPENDS ${fp_prov_key_header})

target_sources(app PRIVATE src/main.c)
target_include_directories(app PRIVATE ${fp_prov_gen_dir})
add_dependencies(app fp_provision_key_gen)
```

## Kconfig
```
#
# Copyright (c) 2026 Nordic Semiconductor ASA
#
# SPDX-License-Identifier: LicenseRef-Nordic-5-Clause
#

# Fast Pair provisioner image.
#
# This image is provided by the Fast Pair subsystem and is meant to be built as
# a separate sysbuild domain of a Fast Pair application (see the input_device
# sample sysbuild.cmake). It provisions the Fast Pair registration data into
# hardware-protected storage:
#   - the Anti-Spoofing private key into a CRACEN KMU slot,
#   - the Model ID into PSA Protected Storage.
# The application then sources the data from there at runtime (see
# fp_registration_data_provision.c).
#
# This file DEFINES the provisioner configuration options and their
# descriptions. It does NOT set their values: the demo credentials and storage
# locations are set once in the application's Kconfig.sysbuild (the single source
# of truth) and injected here by sysbuild via set_config_* in sysbuild.cmake.
# The defaults below are only inert placeholders for a standalone build.

mainmenu "Fast Pair provisioner"

config FP_PROVISION_MODEL_ID
	hex "Fast Pair Model ID"
	default 0x0
	help
	  Fast Pair Model ID written to PSA Protected Storage. Obtained during
	  device model registration in the Google Nearby Console. A 24-bit value
	  (0x000000 - 0xFFFFFF).

config FP_PROVISION_ANTI_SPOOFING_KEY
	string "Fast Pair Anti-Spoofing Private Key (base64)"
	default ""
	help
	  Base64-encoded Anti-Spoofing Private Key imported into the CRACEN KMU.
	  Confidential. It is decoded at build time (see fp_provision_key_gen.py)
	  so no base64 decoding is performed on the device.

config FP_PROVISION_KMU_SLOT
	int "CRACEN KMU slot for the Anti-Spoofing private key"
	default 0
	help
	  KMU slot index (RAW usage scheme) that stores the 256-bit Anti-Spoofing
	  private key. A 256-bit key occupies two consecutive KMU slots, so keep
	  the following slot (this value + 1) free. Must match
	  CONFIG_BT_FAST_PAIR_KMU_SLOT of the application image.

config FP_PROVISION_PS_ID
	int "PSA Protected Storage UID for the Model ID"
	default 0
	help
	  PSA Protected Storage uid used to store the Fast Pair Model ID. Must
	  match CONFIG_BT_FAST_PAIR_PS_ID of the application image.

source "Kconfig.zephyr"
```

## prj.conf
```kconfig
#
# Copyright (c) 2026 Nordic Semiconductor ASA
#
# SPDX-License-Identifier: LicenseRef-Nordic-5-Clause
#

CONFIG_LOG=y

# TF-M is pulled in automatically by the /ns board target and provides the PSA
# Crypto and Protected Storage APIs to this non-secure image.
#
# PSA features needed to import the Fast Pair Anti-Spoofing key (a SECP-R1 ECDH
# key pair) into the CRACEN KMU. Without these, psa_import_key() of an ECC/ECDH
# key returns PSA_ERROR_NOT_SUPPORTED (-134).
CONFIG_PSA_WANT_KEY_TYPE_ECC_KEY_PAIR_IMPORT=y
CONFIG_PSA_WANT_ECC_SECP_R1_256=y
CONFIG_PSA_WANT_ALG_ECDH=y
```

## src/main.c
```c
/*
 * Copyright (c) 2026 Nordic Semiconductor ASA
 *
 * SPDX-License-Identifier: LicenseRef-Nordic-5-Clause
 */

#include <errno.h>
#include <stdint.h>
#include <string.h>

#include <zephyr/kernel.h>
#include <zephyr/logging/log.h>
#include <zephyr/sys/byteorder.h>
#include <zephyr/drivers/flash.h>

#include <psa/crypto.h>
#include <psa/crypto_extra.h>

#include <psa/protected_storage.h>
#include <psa/internal_trusted_storage.h>

#include <psa/storage_common.h>
#include <cracen_psa_kmu.h>
#include <cracen_psa_key_ids.h>

/* Anti-Spoofing key bytes decoded from base64 at build time. Provides
 * fp_provision_anti_spoofing_key[] and FP_PROVISION_ANTI_SPOOFING_KEY_LEN.
 */
#include "fp_provision_key.h"

LOG_MODULE_REGISTER(fp_provision, LOG_LEVEL_INF);

/* Fast Pair Model ID length (24 bits = 3 bytes). */
#define FP_MODEL_ID_LEN		3U

/* Handle of the Anti-Spoofing private key in the KMU (RAW usage scheme). */
#define FP_KMU_KEY_ID \
	PSA_KEY_ID_FROM_CRACEN_KMU_SLOT(CRACEN_KMU_KEY_USAGE_SCHEME_RAW, \
					CONFIG_FP_PROVISION_KMU_SLOT)

/* Protected Storage uid holding the Model ID. */
#define FP_PS_MODEL_ID_UID	((psa_storage_uid_t)CONFIG_FP_PROVISION_PS_ID)

static int scrub_anti_spoofing_key(void)
{
    const struct device *rram = DEVICE_DT_GET(DT_CHOSEN(zephyr_flash_controller));
    uint8_t zeros[FP_PROVISION_ANTI_SPOOFING_KEY_LEN] = {0};   /* 32, a multiple of 16 */
    off_t off = (off_t)(uintptr_t)fp_provision_anti_spoofing_key; /* RRAM base = 0x0 */
    return flash_write(rram, off, zeros, sizeof(zeros));
}

static int provision_init(void)
{
	psa_status_t status = psa_crypto_init();

	if (status != PSA_SUCCESS) {
		LOG_ERR("psa_crypto_init failed (err %d)", status);
		return -EIO;
	}

	return 0;
}

static int provision_anti_spoofing_key(void)
{
	psa_key_attributes_t attr = PSA_KEY_ATTRIBUTES_INIT;
	psa_key_id_t key_id = PSA_KEY_ID_NULL;
	psa_status_t status;

	psa_set_key_usage_flags(&attr, PSA_KEY_USAGE_DERIVE);
	psa_set_key_algorithm(&attr, PSA_ALG_ECDH);
	psa_set_key_type(&attr, PSA_KEY_TYPE_ECC_KEY_PAIR(PSA_ECC_FAMILY_SECP_R1));
	psa_set_key_bits(&attr, FP_PROVISION_ANTI_SPOOFING_KEY_LEN * __CHAR_BIT__);
	psa_set_key_lifetime(&attr,
		PSA_KEY_LIFETIME_FROM_PERSISTENCE_AND_LOCATION(
			CRACEN_KEY_PERSISTENCE_READ_ONLY, PSA_KEY_LOCATION_CRACEN_KMU));
	psa_set_key_id(&attr, FP_KMU_KEY_ID);

	status = psa_import_key(&attr, fp_provision_anti_spoofing_key,
			       FP_PROVISION_ANTI_SPOOFING_KEY_LEN, &key_id);
	psa_reset_key_attributes(&attr);
	if (status != PSA_SUCCESS) {
		LOG_ERR("Anti-Spoofing key provisioning failed (err %d)", status);
		return -EIO;
	}

	LOG_INF("Anti-Spoofing key provisioned to KMU slot %d", CONFIG_FP_PROVISION_KMU_SLOT);

	int err = scrub_anti_spoofing_key();
	if (err != 0) {
		LOG_ERR("NVM memory erase failed (err %d)", err);
		return err;
	}

	return 0;
}

static int provision_model_id(void)
{
	uint8_t model_id[FP_MODEL_ID_LEN];
	psa_status_t status;

	sys_put_be24(CONFIG_FP_PROVISION_MODEL_ID, model_id);

	// status = psa_ps_set(FP_PS_MODEL_ID_UID, sizeof(model_id), model_id, PSA_STORAGE_FLAG_WRITE_ONCE);
	status = psa_its_set(FP_PS_MODEL_ID_UID, sizeof(model_id), model_id, PSA_STORAGE_FLAG_WRITE_ONCE);
	if (status != PSA_SUCCESS) {
		LOG_ERR("Model ID provisioning failed (err %d)", status);
		return -EIO;
	}

	// LOG_INF("Model ID 0x%06x provisioned to Protected Storage (uid %u)",
	// 	CONFIG_FP_PROVISION_MODEL_ID, (unsigned int)FP_PS_MODEL_ID_UID);

	LOG_INF("Model ID 0x%06x provisioned to Internal Trusted Storage (uid %u)",
		CONFIG_FP_PROVISION_MODEL_ID, (unsigned int)FP_PS_MODEL_ID_UID);

	return 0;
}

int main(void)
{
	LOG_INF("Fast Pair provisioner started");

	if (provision_init()) {
		return 0;
	}

	if (provision_anti_spoofing_key()) {
		return 0;
	}

	if (provision_model_id()) {
		return 0;
	}

	LOG_INF("Fast Pair provisioning completed successfully");

	return 0;
}
```
