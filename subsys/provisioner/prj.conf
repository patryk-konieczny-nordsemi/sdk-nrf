## CMakeLists.txt
```
#
# Copyright (c) 2026 Nordic Semiconductor ASA
#
# SPDX-License-Identifier: LicenseRef-Nordic-5-Clause
#
zephyr_library_named(provisioner)
zephyr_library_sources(src/provisioner.c)

zephyr_linker_sources(SECTIONS provisioner_entry.ld)
```

## Kconfig
```
#
# Copyright (c) 2026 Nordic Semiconductor ASA
#
# SPDX-License-Identifier: LicenseRef-Nordic-5-Clause
#

menuconfig PROVISIONER
	bool "Runtime provisioner"
	select PSA_CRYPTO
	select BASE64
	help
	  Enable the runtime credential provisioner (KMU/ITS iterable runner).
	  Enable in provisioner application images only.

if PROVISIONER

config PROVISIONER_MAX_DATA_SIZE
	int "Provisioner entry max data size"
	default 1024
	help
	  Sets the buffer size used for provisioning.
	  Limits the maximum size of a single data entry.

module = PROVISIONER
module-str = Provisioner subsystem
source "$(ZEPHYR_BASE)/subsys/logging/Kconfig.template.log_config"

endif # PROVISIONER
```

## prj.conf
```kconfig
#
# Copyright (c) 2026 Nordic Semiconductor ASA
#
# SPDX-License-Identifier: LicenseRef-Nordic-5-Clause
#

CONFIG_NCS_SAMPLES_DEFAULTS=y

CONFIG_LOG=y
CONFIG_LOG_MODE_IMMEDIATE=y

CONFIG_MAIN_STACK_SIZE=4096

# Enable PSA crypto for secure key and data registration
CONFIG_PSA_CRYPTO=y

# Used to erase the provisionded data from non-secure memory
CONFIG_FLASH=y

# Provides base64_decode()
CONFIG_BASE64=y
```

## src/main.c
```c
/*
 * Copyright (c) 2026 Nordic Semiconductor ASA
 *
 * SPDX-License-Identifier: LicenseRef-Nordic-5-Clause
 */

 #include <errno.h>
 #include <stdint.h>
 #include <string.h>
 
 #include <zephyr/devicetree.h>
 #include <zephyr/drivers/flash.h>
 #include <zephyr/kernel.h>
 #include <zephyr/logging/log.h>
 #include <zephyr/sys/base64.h>
 #include <zephyr/sys/byteorder.h>
 #include <zephyr/sys/util.h>
 
 #include <psa/crypto.h>
 #include <psa/crypto_extra.h>
 #include <psa/internal_trusted_storage.h>
 #include <psa/storage_common.h>
 #include <cracen_psa_kmu.h>
 #include <cracen_psa_key_ids.h>
 
 LOG_MODULE_REGISTER(fp_provision, LOG_LEVEL_INF);
 
 /* RRAM write granularity on this SoC: 128-bit (16-byte) wordline. */
 #define FP_RRAM_WRITE_BLOCK 16U
 
 /* Fast Pair Model ID length (24 bits = 3 bytes). */
 #define FP_MODEL_ID_LEN		3U
 
 /* Fast Pair Anti-Spoofing private key length (256 bits = 32 bytes). */
 #define FP_PROVISION_ANTI_SPOOFING_KEY_LEN 32U
 
 /* Longest expected base64 encoding of the 32-byte Anti-Spoofing key (+ NUL). */
 #define FP_PROVISION_ANTI_SPOOFING_KEY_B64_MAX_LEN 64U
 
 /* Handle of the Anti-Spoofing private key in the KMU (RAW usage scheme). */
 #define FP_KMU_KEY_ID \
     PSA_KEY_ID_FROM_CRACEN_KMU_SLOT(CRACEN_KMU_KEY_USAGE_SCHEME_RAW, \
                     CONFIG_FP_PROVISION_KMU_SLOT)
 
 /* Internal Trusted Storage uid holding the Model ID. */
 #define FP_ITS_MODEL_ID_UID	((psa_storage_uid_t)CONFIG_FP_PROVISION_ITS_ID)
 
 BUILD_ASSERT(FP_PROVISION_ANTI_SPOOFING_KEY_B64_MAX_LEN % FP_RRAM_WRITE_BLOCK == 0U,
     "Key storage must be a whole number of RRAM write blocks");
 
 static const char fp_anti_spoofing_key_b64[FP_PROVISION_ANTI_SPOOFING_KEY_B64_MAX_LEN] __aligned(16) =
         CONFIG_FP_PROVISION_ANTI_SPOOFING_KEY;
 
 
 static int purge_sram_secret(void *buf, size_t len)
 {
     if ((buf == NULL) || (len == 0U)) {
         LOG_ERR("Invalid SRAM purge request");
         return -EINVAL;
     }
 
     memset(buf, 0, len);
 
     return 0;
 }
 
 static int purge_rram_secret(const void *addr, size_t len)
 {
     const struct device *flash_dev = DEVICE_DT_GET(DT_CHOSEN(zephyr_flash_controller));
     uint8_t zeros[FP_PROVISION_ANTI_SPOOFING_KEY_B64_MAX_LEN] = {0};
     size_t wbs;
     off_t off;
     int err;
 
     if ((addr == NULL) || (len == 0U) || (len > sizeof(zeros))) {
         LOG_ERR("Invalid RRAM purge request");
         return -EINVAL;
     }
 
     if (!device_is_ready(flash_dev)) {
         LOG_ERR("Flash device not ready");
         return -ENODEV;
     }
 
     wbs = flash_get_write_block_size(flash_dev);
     off = (off_t)(uintptr_t)addr;
 
 
     if ((((size_t)off % wbs) != 0U) || ((len % wbs) != 0U)) {
         LOG_ERR("RRAM purge region not write-block aligned "
             "(off %ld, len %zu, wbs %zu)", (long)off, len, wbs);
         return -EINVAL;
     }
 
     err = flash_write(flash_dev, off, zeros, len);
     if (err != 0) {
         LOG_ERR("Failed to purge secret from RRAM (err %d)", err);
         return -EIO;
     }
 
     return 0;
 }
 
 static int provision_init(void)
 {
     psa_status_t status = psa_crypto_init();
 
     if (status != PSA_SUCCESS) {
         LOG_ERR("psa_crypto_init failed (err %d)", status);
         return -EIO;
     }
 
     return 0;
 }
 
 static int provision_anti_spoofing_key(void)
 {
     const size_t key_b64_len = strlen(fp_anti_spoofing_key_b64);
     uint8_t fp_provision_anti_spoofing_key[FP_PROVISION_ANTI_SPOOFING_KEY_LEN] = {0};
     size_t bytes_written = 0;
     psa_key_attributes_t attr = PSA_KEY_ATTRIBUTES_INIT;
     psa_key_id_t key_id = PSA_KEY_ID_NULL;
     psa_status_t status;
     int err;
 
     if (key_b64_len == 0U) {
         LOG_ERR("Anti-Spoofing key is empty");
         return -EINVAL;
     }
 
     err = base64_decode(fp_provision_anti_spoofing_key,
                 sizeof(fp_provision_anti_spoofing_key), &bytes_written,
                 (const uint8_t *)fp_anti_spoofing_key_b64, key_b64_len);
     if (err != 0) {
         LOG_ERR("Anti-Spoofing key base64 decode failed (err %d)", err);
         return -EINVAL;
     }
 
     if (bytes_written != FP_PROVISION_ANTI_SPOOFING_KEY_LEN) {
         LOG_ERR("Anti-Spoofing key has invalid length (%zu)", bytes_written);
         return -EINVAL;
     }
 
     psa_set_key_usage_flags(&attr, PSA_KEY_USAGE_DERIVE);
     psa_set_key_algorithm(&attr, PSA_ALG_ECDH);
     psa_set_key_type(&attr, PSA_KEY_TYPE_ECC_KEY_PAIR(PSA_ECC_FAMILY_SECP_R1));
     psa_set_key_bits(&attr, FP_PROVISION_ANTI_SPOOFING_KEY_LEN * __CHAR_BIT__);
     psa_set_key_lifetime(&attr,
                  PSA_KEY_LIFETIME_FROM_PERSISTENCE_AND_LOCATION(
                      CRACEN_KEY_PERSISTENCE_READ_ONLY,
                      PSA_KEY_LOCATION_CRACEN_KMU));
     psa_set_key_id(&attr, FP_KMU_KEY_ID);
 
     status = psa_import_key(&attr, fp_provision_anti_spoofing_key,
                 FP_PROVISION_ANTI_SPOOFING_KEY_LEN, &key_id);
     psa_reset_key_attributes(&attr);
     if (status != PSA_SUCCESS) {
         LOG_ERR("Anti-Spoofing key provisioning failed (err %d)", status);
         return -EIO;
     }
 
     LOG_INF("Anti-Spoofing key provisioned to KMU slot %d", CONFIG_FP_PROVISION_KMU_SLOT);
 
     err = purge_rram_secret(fp_anti_spoofing_key_b64, FP_PROVISION_ANTI_SPOOFING_KEY_B64_MAX_LEN);
     if (err != 0) {
         return err;
     }
 
     err = purge_sram_secret(fp_provision_anti_spoofing_key,
                 sizeof(fp_provision_anti_spoofing_key));
     if (err != 0) {
         LOG_ERR("Failed to purge Anti-Spoofing key from SRAM (err %d)", err);
         return err;
     }
 
     return 0;
 }
 
 static int provision_model_id(void)
 {
     uint8_t model_id[FP_MODEL_ID_LEN];
     psa_status_t status;
 
     sys_put_be24(CONFIG_FP_PROVISION_MODEL_ID, model_id);
 
     status = psa_its_set(FP_ITS_MODEL_ID_UID, sizeof(model_id), model_id,
                  PSA_STORAGE_FLAG_WRITE_ONCE);
     if (status != PSA_SUCCESS) {
         LOG_ERR("Model ID provisioning failed (err %d)", status);
         return -EIO;
     }
 
     LOG_INF("Model ID 0x%06x provisioned to Internal Trusted Storage (uid %u)",
         CONFIG_FP_PROVISION_MODEL_ID, (unsigned int)FP_ITS_MODEL_ID_UID);
 
     return 0;
 }
 
 int main(void)
 {
     LOG_INF("Fast Pair provisioner started");
 
     if (provision_init()) {
         return 0;
     }
 
     if (provision_anti_spoofing_key()) {
         return 0;
     }
 
     if (provision_model_id()) {
         return 0;
     }
 
     LOG_INF("Fast Pair provisioning completed successfully");
 
     return 0;
 }
 
```

## include/provision_entry.h
```c
/*
 * Copyright (c) 2026 Nordic Semiconductor ASA
 *
 * SPDX-License-Identifier: LicenseRef-Nordic-5-Clause
 */

#ifndef PROVISION_ENTRY_H_
#define PROVISION_ENTRY_H_

#include <stddef.h>
#include <stdint.h>

#include <zephyr/sys/iterable_sections.h>
#include <zephyr/sys/util.h>

#include <psa/crypto.h>
#include <psa/crypto_extra.h>
#include <psa/internal_trusted_storage.h>
#include <psa/storage_common.h>

/**
 * @brief Minimum RRAM erase granularity (nRF54L 128-bit wordline).
 *
 * Used for compile-time checks in @ref REGISTER_PROVISION_KMU_ENTRY_SECRET and
 * @ref REGISTER_PROVISION_ITS_ENTRY_SECRET. The provisioner re-checks alignment
 * at runtime against the flash driver write block size.
 */
#define PROVISION_RRAM_ERASE_ALIGN 16U

/** @brief Maximum number of RRAM bytes the provisioner can erase in one entry. */
#define PROVISION_RRAM_ERASE_MAX_LEN 64U

/** @brief Source data encoding for a provision entry. */
enum provision_data_format {
	/** @brief Binary payload; @a payload_length is the exact byte count to read. */
	PROVISION_DATA_FORMAT_RAW = 0,
	/**
	 * @brief Base64-encoded, NUL-terminated text at the start of @a data.
	 *
	 * @a payload_length bounds the decode (strnlen). It must cover the full
	 * encoded string and its terminating NUL, and must not exceed the allocated
	 * @a storage_length when using a @c _SECRET registration macro.
	 */
	PROVISION_DATA_FORMAT_BASE64,
};

/** @brief Generic post-provisioning callback descriptor. */
struct provision_generic_callback {
	/** Entry name (STRINGIFY of the registration symbol). */
	const char *name;
	/** Callback invoked after core provisioning completes. */
	int (*callback)(void);
};

/** @brief PSA Internal Trusted Storage provision entry. */
struct provision_its_entry {
	/** Entry name (STRINGIFY of the registration symbol). */
	const char *name;
	/** Source data pointer. Must remain valid for the life of the image. */
	const void *data;
	/**
	 * Payload extent read from @a data.
	 *
	 * RAW: exact byte count. BASE64: upper bound for strnlen (string + NUL).
	 */
	size_t payload_length;
	/** Encoding of @a data. */
	enum provision_data_format format;
	/** PSA ITS uid. */
	psa_storage_uid_t uid;
	/** Flags passed to psa_its_set(). */
	psa_storage_create_flags_t create_flags;
	/**
	 * RRAM storage extent to erase after a successful write, or 0 to retain
	 * @a data in the image. When non-zero, must be write-block aligned and
	 * be at least @a payload_length (see @ref REGISTER_PROVISION_ITS_ENTRY_SECRET).
	 */
	size_t storage_length;
};

/** @brief CRACEN KMU provision entry. */
struct provision_kmu_entry {
	/** Entry name (STRINGIFY of the registration symbol). */
	const char *name;
	/** Source data pointer. Must remain valid for the life of the image. */
	const void *data;
	/**
	 * Payload extent read from @a data.
	 *
	 * RAW: exact byte count. BASE64: upper bound for strnlen (string + NUL).
	 */
	size_t payload_length;
	/** Key size in bits passed to psa_set_key_bits(). */
	size_t key_bits;
	/** Encoding of @a data. */
	enum provision_data_format format;
	/** PSA key identifier (KMU slot mapping). */
	psa_key_id_t id;
	/** PSA key type. */
	psa_key_type_t type;
	/** PSA key lifetime. */
	psa_key_lifetime_t lifetime;
	/** PSA key usage flags. */
	psa_key_usage_t usage_flags;
	/** PSA key algorithm. */
	psa_algorithm_t alg;
	/**
	 * RRAM storage extent to erase after a successful import, or 0 to retain
	 * @a data in the image. When non-zero, must be write-block aligned and be
	 * at least @a payload_length (see @ref REGISTER_PROVISION_KMU_ENTRY_SECRET).
	 */
	size_t storage_length;
};

/** @brief Compile-time checks shared by ITS and KMU secret registration macros. */
#define PROVISION_SECRET_STORAGE_ASSERT(_data, _payload_length, _storage_length)                   	\
	BUILD_ASSERT((_storage_length) > 0U, "storage_length must be non-zero for secret entries");		\
	BUILD_ASSERT((_storage_length) <= PROVISION_RRAM_ERASE_MAX_LEN,                            		\
		     "storage_length exceeds provisioner limit");                                  			\
	BUILD_ASSERT((_storage_length) >= (_payload_length),                                       		\
		     "storage_length must cover the payload region");                              			\
	BUILD_ASSERT(((_storage_length) % PROVISION_RRAM_ERASE_ALIGN) == 0U,                       		\
		     "storage_length must be RRAM write-block aligned");                           			\
	BUILD_ASSERT((((uintptr_t)(_data)) % PROVISION_RRAM_ERASE_ALIGN) == 0U,                   		\
		     "secret data address must be RRAM write-block aligned")

/** @brief Register a generic post-provisioning callback. */
#define REGISTER_PROVISION_GENERIC_CALLBACK(_name, _callback)                                   \
	static const STRUCT_SECTION_ITERABLE(provision_generic_callback, _name) = {                 \
		.name = STRINGIFY(_name),                                                              	\
		.callback = (_callback),                                                               	\
	}

/** @brief Register a PSA ITS entry (source data retained in the image). */
#define REGISTER_PROVISION_ITS_ENTRY(_name, _data, _payload_length, _format, _uid,              \
				     _create_flags)                                                				\
	static const STRUCT_SECTION_ITERABLE(provision_its_entry, _name) = {      	\
		.name = STRINGIFY(_name),                                             	\
		.data = (_data),                                                      	\
		.payload_length = (_payload_length),                                  	\
		.format = (_format),                                                  	\
		.uid = (_uid),                                                        	\
		.create_flags = (_create_flags),                                      	\
		.storage_length = 0,                                                  	\
	}

/**
 * @brief Register a PSA ITS entry backed by RRAM-resident secret data.
 *
 * @param _payload_length Bytes read from @p _data (payload / string + NUL).
 * @param _storage_length Full RRAM allocation erased after success (aligned,
 *                        >= @p _payload_length, typically `sizeof(_data)`).
 */
#define REGISTER_PROVISION_ITS_ENTRY_SECRET(_name, _data, _payload_length, _storage_length,     \
					    _format, _uid, _create_flags)                            				\
	PROVISION_SECRET_STORAGE_ASSERT(_data, _payload_length, _storage_length);	\
	static const STRUCT_SECTION_ITERABLE(provision_its_entry, _name) = {     	\
		.name = STRINGIFY(_name),                                            	\
		.data = (_data),                                                     	\
		.payload_length = (_payload_length),                                 	\
		.format = (_format),                                                 	\
		.uid = (_uid),                                                       	\
		.create_flags = (_create_flags),                                     	\
		.storage_length = (_storage_length),                                 	\
	}

/** @brief Register a CRACEN KMU entry (source data retained in the image). */
#define REGISTER_PROVISION_KMU_ENTRY(_name, _data, _payload_length, _key_bits, _format, _id,   	\
				     _type, _lifetime, _usage_flags, _alg)                         				\
	static const STRUCT_SECTION_ITERABLE(provision_kmu_entry, _name) = {		\
		.name = STRINGIFY(_name),                                       		\
		.data = (_data),                                                		\
		.payload_length = (_payload_length),                            		\
		.key_bits = (_key_bits),                                        		\
		.format = (_format),                                            		\
		.id = (_id),                                                    		\
		.type = (_type),                                                		\
		.lifetime = (_lifetime),                                        		\
		.usage_flags = (_usage_flags),                                  		\
		.alg = (_alg),                                                  		\
		.storage_length = 0,                                            		\
	}

/**
 * @brief Register a CRACEN KMU entry backed by RRAM-resident secret data.
 *
 * @param _payload_length Bytes read from @p _data (payload / string + NUL).
 * @param _storage_length Full RRAM allocation erased after success (aligned,
 *                        >= @p _payload_length, typically `sizeof(_data)`).
 */
#define REGISTER_PROVISION_KMU_ENTRY_SECRET(_name, _data, _payload_length, _storage_length,		\
					    _key_bits, _format, _id, _type, _lifetime,             					\
					    _usage_flags, _alg)                                     				\
	PROVISION_SECRET_STORAGE_ASSERT(_data, _payload_length, _storage_length);	\
	static const STRUCT_SECTION_ITERABLE(provision_kmu_entry, _name) = {        \
		.name = STRINGIFY(_name),                                               \
		.data = (_data),                                                        \
		.payload_length = (_payload_length),                                    \
		.key_bits = (_key_bits),                                                \
		.format = (_format),                                                    \
		.id = (_id),                                                            \
		.type = (_type),                                                        \
		.lifetime = (_lifetime),                                                \
		.usage_flags = (_usage_flags),                                          \
		.alg = (_alg),                                                          \
		.storage_length = (_storage_length),                                    \
	}

#endif /* PROVISION_ENTRY_H_ */
```

## src/provisioner.c
```c
/*
 * Copyright (c) 2026 Nordic Semiconductor ASA
 *
 * SPDX-License-Identifier: LicenseRef-Nordic-5-Clause
 */

#include <errno.h>
#include <limits.h>
#include <string.h>

#include <zephyr/kernel.h>
#include <zephyr/logging/log.h>
#include <zephyr/sys/base64.h>
#include <mbedtls/platform_util.h>

#include <psa/crypto.h>
#include <psa/internal_trusted_storage.h>
#include <cracen_psa_kmu.h>

#include <provisioner/provisioner.h>

LOG_MODULE_REGISTER(provisioner, CONFIG_PROVISIONER_LOG_LEVEL);

static int provision_init(void)
{
	psa_status_t status = psa_crypto_init();

	if (status != PSA_SUCCESS) {
		LOG_ERR("psa_crypto_init failed (err: %d)", status);
		return -EIO;
	}

	return 0;
}

static int provision_payload_get(const struct provisioner_data *prov_data, uint8_t *buf,
				 size_t buf_len, size_t *out_len)
{
	if (prov_data == NULL || prov_data->data == NULL || buf == NULL || out_len == NULL) {
		return -EINVAL;
	}

	switch (prov_data->format) {
	case PROVISIONER_DATA_FORMAT_RAW:
		if (prov_data->payload_length > buf_len) {
			return -EINVAL;
		}

		memcpy(buf, prov_data->data, prov_data->payload_length);
		*out_len = prov_data->payload_length;
		return 0;

	case PROVISIONER_DATA_FORMAT_BASE64: {
		size_t enc_len = strnlen(prov_data->data, prov_data->payload_length);
		int err;

		if (enc_len == 0U) {
			return -EINVAL;
		}

		err = base64_decode(buf, buf_len, out_len, prov_data->data, enc_len);
		if (err != 0) {
			return -EINVAL;
		}

		return 0;
	}

	default:
		return -EINVAL;
	}
}

static int provision_its_entry_verify(const struct provisioner_its_entry *entry,
				      const uint8_t *payload, size_t payload_len,
				      const struct psa_storage_info_t *info)
{
	uint8_t stored[CONFIG_PROVISIONER_MAX_DATA_SIZE];
	size_t stored_len = 0;
	psa_status_t status;
	int ret = 0;

	if (info->flags != entry->config.create_flags || info->size != payload_len) {
		LOG_ERR("Entry %s: data already stored (configuration mismatch) "
			"in ITS uid: 0x%08x", entry->name, (unsigned int)entry->config.uid);
		return -EEXIST;
	}

	status = psa_its_get(entry->config.uid, 0, info->size, stored, &stored_len);
	if (status != PSA_SUCCESS) {
		LOG_ERR("Entry %s: ITS read failed (err: %d)", entry->name, status);
		return -EIO;
	} else if (stored_len == payload_len && memcmp(stored, payload, payload_len) == 0) {
		LOG_WRN("Entry %s: identical data already provisioned in ITS uid: 0x%08x",
			entry->name, (unsigned int)entry->config.uid);
	} else {
		LOG_ERR("Entry %s: data already stored (different value) in ITS uid: 0x%08x",
			entry->name, (unsigned int)entry->config.uid);
		ret = -EEXIST;
	}

	mbedtls_platform_zeroize(stored, sizeof(stored));

	return ret;
}

static int provision_its_entries_run(void)
{
	int ret_val = 0;

	STRUCT_SECTION_FOREACH(provisioner_its_entry, entry) {
		uint8_t payload[CONFIG_PROVISIONER_MAX_DATA_SIZE];
		struct psa_storage_info_t info;
		size_t payload_len = 0;
		psa_status_t status;
		int err;

		err = provision_payload_get(&entry->prov_data, payload, sizeof(payload),
					    &payload_len);
		if (err != 0) {
			LOG_ERR("Entry %s: invalid payload (err: %d)", entry->name, err);
			mbedtls_platform_zeroize(payload, sizeof(payload));
			ret_val = ret_val ? ret_val : err;
			continue;
		}

		status = psa_its_get_info(entry->config.uid, &info);
		if (status != PSA_SUCCESS && status != PSA_ERROR_DOES_NOT_EXIST) {
			LOG_ERR("Entry %s: ITS info check failed (err: %d)", entry->name, status);
			mbedtls_platform_zeroize(payload, sizeof(payload));
			ret_val = ret_val ? ret_val : -EIO;
			continue;
		} else if (status == PSA_SUCCESS) {
			err = provision_its_entry_verify(entry, payload, payload_len, &info);
			if (err != 0) {
				ret_val = ret_val ? ret_val : err;
			}
			mbedtls_platform_zeroize(payload, sizeof(payload));
			continue;
		}

		status = psa_its_set(entry->config.uid, payload_len, payload,
				     entry->config.create_flags);
		if (status != PSA_SUCCESS) {
			LOG_ERR("Entry %s: ITS write failed (err: %d)", entry->name, status);
			mbedtls_platform_zeroize(payload, sizeof(payload));
			ret_val = ret_val ? ret_val : -EIO;
			continue;
		}

		LOG_INF("Entry %s: provisioned to ITS uid: 0x%08x", entry->name,
			(unsigned int)entry->config.uid);

		mbedtls_platform_zeroize(payload, sizeof(payload));
	}

	return ret_val;
}

static int provision_kmu_entries_run(void)
{
	int ret_val = 0;

	STRUCT_SECTION_FOREACH(provisioner_kmu_entry, entry) {
		unsigned int slot = CRACEN_PSA_GET_KMU_SLOT(entry->config.id);
		uint8_t payload[CONFIG_PROVISIONER_MAX_DATA_SIZE];
		size_t payload_len = 0;
		psa_key_attributes_t attr = PSA_KEY_ATTRIBUTES_INIT;
		psa_key_id_t key_id = PSA_KEY_ID_NULL;
		psa_status_t status;
		int err;

		err = provision_payload_get(&entry->prov_data, payload, sizeof(payload),
					    &payload_len);
		if (err != 0) {
			LOG_ERR("Entry %s: invalid payload (err: %d)", entry->name, err);
			mbedtls_platform_zeroize(payload, sizeof(payload));
			ret_val = ret_val ? ret_val : err;
			continue;
		} else if (payload_len != PSA_BITS_TO_BYTES(entry->config.key_bits)) {
			LOG_ERR("Entry %s: decoded length %zu does not match key size %zu bits",
				entry->name, payload_len, entry->config.key_bits);
			mbedtls_platform_zeroize(payload, sizeof(payload));
			ret_val = ret_val ? ret_val : -EINVAL;
			continue;
		}

		psa_set_key_id(&attr, entry->config.id);
		psa_set_key_type(&attr, entry->config.type);
		psa_set_key_bits(&attr, entry->config.key_bits);
		psa_set_key_lifetime(&attr, entry->config.lifetime);
		psa_set_key_usage_flags(&attr, entry->config.usage_flags);
		psa_set_key_algorithm(&attr, entry->config.alg);

		status = psa_import_key(&attr, payload, payload_len, &key_id);
		psa_reset_key_attributes(&attr);
		if (status == PSA_ERROR_ALREADY_EXISTS) {
			LOG_ERR("Entry %s: key collision - KMU slot %u already occupied",
				entry->name, slot);
			mbedtls_platform_zeroize(payload, sizeof(payload));
			ret_val = ret_val ? ret_val : -EEXIST;
			continue;
		} else if (status != PSA_SUCCESS) {
			LOG_ERR("Entry %s: KMU import failed (err: %d)", entry->name, status);
			mbedtls_platform_zeroize(payload, sizeof(payload));
			ret_val = ret_val ? ret_val : -EIO;
			continue;
		}

		status = psa_purge_key(key_id);
		if (status != PSA_SUCCESS) {
			LOG_ERR("Entry %s: KMU psa_purge_key failed (err: %d)", entry->name,
				status);
			mbedtls_platform_zeroize(payload, sizeof(payload));
			ret_val = ret_val ? ret_val : -EIO;
			continue;
		}

		LOG_INF("Entry %s: provisioned to KMU slot: %u", entry->name, slot);

		mbedtls_platform_zeroize(payload, sizeof(payload));
	}

	return ret_val;
}

int provisioner_run(void)
{
	int err;
	int kmu_err;
	int its_err;

	LOG_INF("Provisioner started");

	err = provision_init();
	if (err != 0) {
		return err;
	}

	kmu_err = provision_kmu_entries_run();
	if (kmu_err != 0) {
		LOG_ERR("KMU provisioning failed (err: %d); see entry logs above for details",
			kmu_err);
	} else {
		LOG_INF("KMU provisioning finished - all entries OK");
	}

	its_err = provision_its_entries_run();
	if (its_err != 0) {
		LOG_ERR("ITS provisioning failed (err: %d); see entry logs above for details",
			its_err);
	} else {
		LOG_INF("ITS provisioning finished - all entries OK");
	}

	if (kmu_err != 0 || its_err != 0) {
		LOG_ERR("Provisioning failed");
		return (kmu_err != 0) ? kmu_err : its_err;
	}

	LOG_INF("Provisioning completed successfully");
	return 0;
}
```

## src/provisioner_main.c
```c
/*
 * Copyright (c) 2026 Nordic Semiconductor ASA
 *
 * SPDX-License-Identifier: LicenseRef-Nordic-5-Clause
 */

#include <provisioner/provisioner.h>

#include <zephyr/kernel.h>

int main(void)
{
	return provision_data();
}
```
