## CMakeLists.txt
```
#
# Copyright (c) 2026 Nordic Semiconductor ASA
#
# SPDX-License-Identifier: LicenseRef-Nordic-5-Clause
#

cmake_minimum_required(VERSION 3.20.0)
find_package(Zephyr REQUIRED HINTS $ENV{ZEPHYR_BASE})
project("Fast Pair EIK operations unit test")

set(NCS_FAST_PAIR_BASE ${ZEPHYR_NRF_MODULE_DIR}/subsys/bluetooth/fast_pair)
set(EIK_OPS_DIR ${NCS_FAST_PAIR_BASE}/fhn/fp_fhn_eik_operations)

target_sources(app PRIVATE src/main.c)

add_subdirectory(${NCS_FAST_PAIR_BASE}/fp_crypto fp_crypto)
target_link_libraries(app PRIVATE fp_crypto)

add_subdirectory(${NCS_FAST_PAIR_BASE}/fp_storage fp_storage)
target_link_libraries(app PRIVATE fp_storage)

target_include_directories(app PRIVATE
  ${NCS_FAST_PAIR_BASE}/fhn/include_priv
  ${EIK_OPS_DIR}/include
)

add_library(fhn OBJECT)
target_link_libraries(fhn PRIVATE zephyr_interface fp_crypto fp_storage)
target_include_directories(fhn PRIVATE
  ${NCS_FAST_PAIR_BASE}/fhn/include_priv
  ${NCS_FAST_PAIR_BASE}/include/common
)

add_subdirectory(${EIK_OPS_DIR} fp_fhn_eik_operations)

target_link_libraries(app PRIVATE fhn)
```

## Kconfig
```
#
# Copyright (c) 2026 Nordic Semiconductor
#
# SPDX-License-Identifier: LicenseRef-Nordic-5-Clause
#

choice TEST_BT_FAST_PAIR_CRYPTO_BACKEND
	prompt "Fast Pair crypto test backend"
	optional
	help
	  Select the cryptographic backend configuration used by the test.
	  Leave unset to use the Oberon backend from prj.conf.

config TEST_BT_FAST_PAIR_CRYPTO_PSA
	bool "Enable PSA backend and dependencies"
	help
	  Enable the PSA cryptographic backend for the test and pull in
	  related dependencies. Used to avoid board-specific Kconfig overlays.

config TEST_BT_FAST_PAIR_CRYPTO_CUSTOM
	bool "Enable custom crypto backend and dependencies"
	help
	  Enable the custom (TFM + Oberon) cryptographic backend for the test and
	  pull in related dependencies. Used to avoid board-specific Kconfig overlays.

endchoice

if TEST_BT_FAST_PAIR_CRYPTO_PSA

choice BT_FAST_PAIR_CRYPTO_BACKEND
	default BT_FAST_PAIR_CRYPTO_PSA
endchoice

endif # TEST_BT_FAST_PAIR_CRYPTO_PSA

if TEST_BT_FAST_PAIR_CRYPTO_CUSTOM

choice BT_FAST_PAIR_CRYPTO_BACKEND
	default BT_FAST_PAIR_CRYPTO_CUSTOM
endchoice

endif # TEST_BT_FAST_PAIR_CRYPTO_CUSTOM

config TEST_BT_FAST_PAIR_EIK_SPE
	bool "Use SPE/ITS EIK path instead of NS settings"
	depends on BUILD_WITH_TFM
	help
	  Enable TF-M EIK secure partition path.

config BT_FAST_PAIR_STORAGE_FHN_EIK
	default y if !TEST_BT_FAST_PAIR_EIK_SPE

config BT_FAST_PAIR_FHN_EIK_SPE
	default TEST_BT_FAST_PAIR_EIK_SPE

choice BT_FAST_PAIR_FHN_ECC_TYPE
	default BT_FAST_PAIR_FHN_ECC_SECP256R1
endchoice

config BT_FAST_PAIR_FHN_EIK
	bool
	default y
	help
	  Enable FHN EIK operations in this unit test without the FHN State
	  module or full Bluetooth integration.

menu "Test configuration"
source "$(ZEPHYR_NRF_MODULE_DIR)/subsys/bluetooth/fast_pair/fp_crypto/Kconfig.fp_crypto"
source "$(ZEPHYR_NRF_MODULE_DIR)/subsys/bluetooth/fast_pair/fp_storage/Kconfig.fp_storage"
rsource "$(ZEPHYR_NRF_MODULE_DIR)/subsys/bluetooth/fast_pair/fhn/Kconfig.fhn_crypto"
rsource "$(ZEPHYR_NRF_MODULE_DIR)/subsys/bluetooth/fast_pair/fhn/Kconfig.eik"

module = BT_FAST_PAIR
module-str = Fast Pair
source "$(ZEPHYR_BASE)/subsys/logging/Kconfig.template.log_config"

endmenu

menu "Zephyr"
source "Kconfig.zephyr"
endmenu
```

## prj.conf
```kconfig
#
# Copyright (c) 2026 Nordic Semiconductor ASA
#
# SPDX-License-Identifier: LicenseRef-Nordic-5-Clause
#

CONFIG_ZTEST=y
CONFIG_ZTEST_SHUFFLE=y
CONFIG_ZTEST_SHUFFLE_SUITE_REPEAT_COUNT=1
CONFIG_ZTEST_SHUFFLE_TEST_REPEAT_COUNT=2

CONFIG_SETTINGS=y
CONFIG_SETTINGS_NVS=y
CONFIG_NVS=y
CONFIG_FLASH=y
CONFIG_FLASH_MAP=y

CONFIG_LOG=y
CONFIG_BT_FAST_PAIR_LOG_LEVEL_ERR=y

CONFIG_BT_FAST_PAIR_CRYPTO_OBERON=y
```

## prj_spe.conf
```kconfig
#
# Copyright (c) 2026 Nordic Semiconductor ASA
#
# SPDX-License-Identifier: LicenseRef-Nordic-5-Clause
#

CONFIG_ZTEST=y
CONFIG_ZTEST_SHUFFLE=y
CONFIG_ZTEST_SHUFFLE_SUITE_REPEAT_COUNT=1
CONFIG_ZTEST_SHUFFLE_TEST_REPEAT_COUNT=2

CONFIG_SETTINGS=y
CONFIG_SETTINGS_NVS=y
CONFIG_NVS=y
CONFIG_FLASH=y
CONFIG_FLASH_MAP=y

CONFIG_LOG=y
CONFIG_BT_FAST_PAIR_LOG_LEVEL_ERR=y

CONFIG_TEST_BT_FAST_PAIR_CRYPTO_CUSTOM=y
CONFIG_TEST_BT_FAST_PAIR_EIK_SPE=y

CONFIG_BT_FAST_PAIR_FHN_EIK_SPE_LOG_LEVEL_DBG=y
```

## src/main.c
```c
/*
 * Copyright (c) 2026 Nordic Semiconductor ASA
 *
 * SPDX-License-Identifier: LicenseRef-Nordic-5-Clause
 */

#include <zephyr/ztest.h>
#include <zephyr/settings/settings.h>

#include "fp_storage.h"
#include "fp_fhn_eik_operations.h"

#define FP_RANDOM_NONCE_LEN CONFIG_BT_FAST_PAIR_FHN_RANDOM_NONCE_LEN

static void eik_storage_setup(void)
{
	int err;

	err = settings_subsys_init();
	zassert_ok(err, "settings_subsys_init failed");

	err = settings_load();
	zassert_ok(err, "settings_load failed");

	err = fp_storage_init();
	zassert_ok(err, "fp_storage_init failed");
}

static void eik_before(void *fixture)
{
	ARG_UNUSED(fixture);

	if (!IS_ENABLED(CONFIG_BT_FAST_PAIR_FHN_EIK_SPE)) {
		eik_storage_setup();
	}

	zassert_ok(fp_fhn_eik_delete(), "EIK delete failed");
	zassert_equal(fp_fhn_eik_is_provisioned(), 0, "EIK not unprovisioned");
}

static void eik_after(void *fixture)
{
	ARG_UNUSED(fixture);

	zassert_ok(fp_fhn_eik_delete(), "EIK delete failed");

	if (!IS_ENABLED(CONFIG_BT_FAST_PAIR_FHN_EIK_SPE)) {
		zassert_ok(fp_storage_uninit(), "fp_storage_init failed");
	}
}

ZTEST(eik_suite, test_delete_unprovisioned)
{
	zassert_ok(fp_fhn_eik_delete());
	zassert_equal(fp_fhn_eik_is_provisioned(), 0);
}

ZTEST(eik_suite, test_provision)
{
	static const uint8_t account_key[FP_FHN_ACCOUNT_KEY_LEN] = {
		0x01, 0x23, 0x45, 0x67, 0x89, 0xab, 0xcd, 0xef,
		0x01, 0x23, 0x45, 0x67, 0x89, 0xab, 0xcd, 0xef,
	};
	static const uint8_t encrypted_eik[FP_FHN_ENCRYPTED_EIK_LEN] = {
		0xa1, 0xee, 0x56, 0x08, 0xb3, 0x3a, 0xf0, 0x54,
		0x70, 0x85, 0x86, 0x08, 0xd1, 0xde, 0x08, 0x0f,
		0xa1, 0xee, 0x56, 0x08, 0xb3, 0x3a, 0xf0, 0x54,
		0x70, 0x85, 0x86, 0x08, 0xd1, 0xde, 0x08, 0x0f,
	};

	zassert_ok(fp_fhn_eik_provision_encrypted(encrypted_eik, account_key));
	zassert_equal(fp_fhn_eik_is_provisioned(), 1);
}

ZTEST(eik_suite, test_delete_provisioned)
{
	static const uint8_t account_key[FP_FHN_ACCOUNT_KEY_LEN] = {
		0x01, 0x23, 0x45, 0x67, 0x89, 0xab, 0xcd, 0xef,
		0x01, 0x23, 0x45, 0x67, 0x89, 0xab, 0xcd, 0xef,
	};
	static const uint8_t encrypted_eik[FP_FHN_ENCRYPTED_EIK_LEN] = {
		0xa1, 0xee, 0x56, 0x08, 0xb3, 0x3a, 0xf0, 0x54,
		0x70, 0x85, 0x86, 0x08, 0xd1, 0xde, 0x08, 0x0f,
		0xa1, 0xee, 0x56, 0x08, 0xb3, 0x3a, 0xf0, 0x54,
		0x70, 0x85, 0x86, 0x08, 0xd1, 0xde, 0x08, 0x0f,
	};

	zassert_ok(fp_fhn_eik_provision_encrypted(encrypted_eik, account_key));
	zassert_equal(fp_fhn_eik_is_provisioned(), 1);

	zassert_ok(fp_fhn_eik_delete());
	zassert_equal(fp_fhn_eik_is_provisioned(), 0);
}

ZTEST(eik_suite, test_hash_compare_match)
{
	static const uint8_t account_key[FP_FHN_ACCOUNT_KEY_LEN] = {
		0x01, 0x23, 0x45, 0x67, 0x89, 0xab, 0xcd, 0xef,
		0x01, 0x23, 0x45, 0x67, 0x89, 0xab, 0xcd, 0xef,
	};
	static const uint8_t encrypted_eik[FP_FHN_ENCRYPTED_EIK_LEN] = {
		0xa1, 0xee, 0x56, 0x08, 0xb3, 0x3a, 0xf0, 0x54,
		0x70, 0x85, 0x86, 0x08, 0xd1, 0xde, 0x08, 0x0f,
		0xa1, 0xee, 0x56, 0x08, 0xb3, 0x3a, 0xf0, 0x54,
		0x70, 0x85, 0x86, 0x08, 0xd1, 0xde, 0x08, 0x0f,
	};
	static const uint8_t random_nonce[FP_RANDOM_NONCE_LEN] = {
		0x11, 0x22, 0x33, 0x44, 0x55, 0x66, 0x77, 0x88,
	};
	static const uint8_t eik_hash_ref[FP_FHN_EIK_HASH_COMPARE_LEN] = {
		0x06, 0x4a, 0x17, 0x1b, 0xf4, 0xb8, 0x20, 0xb8,
	};

	zassert_ok(fp_fhn_eik_provision_encrypted(encrypted_eik, account_key));
	zassert_true(fp_fhn_eik_hash_compare(eik_hash_ref, random_nonce));
}

ZTEST(eik_suite, test_hash_compare_mismatch)
{
	static const uint8_t account_key[FP_FHN_ACCOUNT_KEY_LEN] = {
		0x01, 0x23, 0x45, 0x67, 0x89, 0xab, 0xcd, 0xef,
		0x01, 0x23, 0x45, 0x67, 0x89, 0xab, 0xcd, 0xef,
	};
	static const uint8_t encrypted_eik[FP_FHN_ENCRYPTED_EIK_LEN] = {
		0xa1, 0xee, 0x56, 0x08, 0xb3, 0x3a, 0xf0, 0x54,
		0x70, 0x85, 0x86, 0x08, 0xd1, 0xde, 0x08, 0x0f,
		0xa1, 0xee, 0x56, 0x08, 0xb3, 0x3a, 0xf0, 0x54,
		0x70, 0x85, 0x86, 0x08, 0xd1, 0xde, 0x08, 0x0f,
	};
	static const uint8_t random_nonce[FP_RANDOM_NONCE_LEN] = {
		0x11, 0x22, 0x33, 0x44, 0x55, 0x66, 0x77, 0x88,
	};
	static const uint8_t eik_hash_invalid[FP_FHN_EIK_HASH_COMPARE_LEN] = {
		0x00, 0x00, 0x00, 0x00, 0x00, 0x00, 0x00, 0x00,
	};

	zassert_ok(fp_fhn_eik_provision_encrypted(encrypted_eik, account_key));
	zassert_false(fp_fhn_eik_hash_compare(eik_hash_invalid, random_nonce));
}

ZTEST(eik_suite, test_eik_get_encrypted)
{
	static const uint8_t owner_account_key[FP_FHN_ACCOUNT_KEY_LEN] = {
		0x01, 0x23, 0x45, 0x67, 0x89, 0xab, 0xcd, 0xef,
		0x01, 0x23, 0x45, 0x67, 0x89, 0xab, 0xcd, 0xef,
	};
	static const uint8_t encrypted_eik[FP_FHN_ENCRYPTED_EIK_LEN] = {
		0xa1, 0xee, 0x56, 0x08, 0xb3, 0x3a, 0xf0, 0x54,
		0x70, 0x85, 0x86, 0x08, 0xd1, 0xde, 0x08, 0x0f,
		0xa1, 0xee, 0x56, 0x08, 0xb3, 0x3a, 0xf0, 0x54,
		0x70, 0x85, 0x86, 0x08, 0xd1, 0xde, 0x08, 0x0f,
	};

	uint8_t encrypted_eik_out[FP_FHN_ENCRYPTED_EIK_LEN];

	zassert_ok(fp_fhn_eik_provision_encrypted(encrypted_eik, owner_account_key));
	zassert_ok(fp_fhn_eik_get_encrypted(owner_account_key, encrypted_eik_out));
	zassert_mem_equal(encrypted_eik_out, encrypted_eik, sizeof(encrypted_eik),
			  "Invalid encrypted EIK round-trip");
}

ZTEST(eik_suite, test_eid_encode)
{
	static const uint8_t account_key[FP_FHN_ACCOUNT_KEY_LEN] = {
		0x01, 0x23, 0x45, 0x67, 0x89, 0xab, 0xcd, 0xef,
		0x01, 0x23, 0x45, 0x67, 0x89, 0xab, 0xcd, 0xef,
	};
	static const uint8_t encrypted_eik[FP_FHN_ENCRYPTED_EIK_LEN] = {
		0xa1, 0xee, 0x56, 0x08, 0xb3, 0x3a, 0xf0, 0x54,
		0x70, 0x85, 0x86, 0x08, 0xd1, 0xde, 0x08, 0x0f,
		0xa1, 0xee, 0x56, 0x08, 0xb3, 0x3a, 0xf0, 0x54,
		0x70, 0x85, 0x86, 0x08, 0xd1, 0xde, 0x08, 0x0f,
	};
	static const uint8_t eid_seed[FP_FHN_EID_SEED_LEN] = {
		0xff, 0xff, 0xff, 0xff, 0xff, 0xff, 0xff, 0xff,
		0xff, 0xff, 0xff, 0x0a, 0x12, 0x34, 0x54, 0x00,
		0x00, 0x00, 0x00, 0x00, 0x00, 0x00, 0x00, 0x00,
		0x00, 0x00, 0x00, 0x0a, 0x12, 0x34, 0x54, 0x00,
	};
	static const uint8_t fhn_eid_ref[FP_FHN_STATE_EID_LEN] = {
		0xac, 0xc5, 0x9d, 0xd9, 0x86, 0x96, 0x06, 0xe1,
		0xeb, 0x6b, 0x47, 0x9e, 0x34, 0x68, 0x89, 0xd9,
		0x8f, 0x4e, 0x85, 0x40, 0xbc, 0x41, 0xad, 0xe6,
		0x56, 0xac, 0xc5, 0x85, 0x4a, 0x4f, 0x90, 0x1c,
	};
	static const uint8_t hashed_flags_xor_operand_ref = 0x10;

	uint8_t fhn_eid[FP_FHN_STATE_EID_LEN];
	uint8_t hashed_flags_xor_operand;

	zassert_ok(fp_fhn_eik_provision_encrypted(encrypted_eik, account_key));
	zassert_ok(fp_fhn_eik_eid_encode(eid_seed, fhn_eid, &hashed_flags_xor_operand));
	zassert_mem_equal(fhn_eid, fhn_eid_ref, sizeof(fhn_eid_ref), "Invalid EID");
	zassert_equal(hashed_flags_xor_operand, hashed_flags_xor_operand_ref,
		"Invalid hashed flags XOR operand");
}

ZTEST(eik_suite, test_derive_keys_recovery)
{
	static const uint8_t account_key[FP_FHN_ACCOUNT_KEY_LEN] = {
		0x01, 0x23, 0x45, 0x67, 0x89, 0xab, 0xcd, 0xef,
		0x01, 0x23, 0x45, 0x67, 0x89, 0xab, 0xcd, 0xef,
	};
	static const uint8_t encrypted_eik[FP_FHN_ENCRYPTED_EIK_LEN] = {
		0xa1, 0xee, 0x56, 0x08, 0xb3, 0x3a, 0xf0, 0x54,
		0x70, 0x85, 0x86, 0x08, 0xd1, 0xde, 0x08, 0x0f,
		0xa1, 0xee, 0x56, 0x08, 0xb3, 0x3a, 0xf0, 0x54,
		0x70, 0x85, 0x86, 0x08, 0xd1, 0xde, 0x08, 0x0f,
	};
	static const uint8_t derived_key_ref[FP_FHN_EIK_DERIVED_KEY_MAX_LEN] = {
		0x6e, 0x80, 0x25, 0x47, 0x42, 0x6f, 0xfe, 0x51,
		0xcb, 0xc0, 0x22, 0x42, 0x10, 0x69, 0x93, 0xee,
		0xf8, 0x99, 0x38, 0x8b, 0x7a, 0x29, 0xe9, 0xc3,
		0xe8, 0x6c, 0x19, 0xc1, 0xc8, 0x37, 0xc5, 0xdc,
	};
	static const uint8_t seed_end_byte = 0x01;

	uint8_t derived_key[FP_FHN_EIK_DERIVED_KEY_MAX_LEN];

	zassert_ok(fp_fhn_eik_provision_encrypted(encrypted_eik, account_key));
	zassert_ok(fp_fhn_eik_derive_key(seed_end_byte, derived_key, sizeof(derived_key)));
	zassert_mem_equal(derived_key, derived_key_ref, sizeof(derived_key_ref),
			  "Invalid recovery derived key");
}

ZTEST(eik_suite, test_derive_keys_ring)
{
	static const uint8_t account_key[FP_FHN_ACCOUNT_KEY_LEN] = {
		0x01, 0x23, 0x45, 0x67, 0x89, 0xab, 0xcd, 0xef,
		0x01, 0x23, 0x45, 0x67, 0x89, 0xab, 0xcd, 0xef,
	};
	static const uint8_t encrypted_eik[FP_FHN_ENCRYPTED_EIK_LEN] = {
		0xa1, 0xee, 0x56, 0x08, 0xb3, 0x3a, 0xf0, 0x54,
		0x70, 0x85, 0x86, 0x08, 0xd1, 0xde, 0x08, 0x0f,
		0xa1, 0xee, 0x56, 0x08, 0xb3, 0x3a, 0xf0, 0x54,
		0x70, 0x85, 0x86, 0x08, 0xd1, 0xde, 0x08, 0x0f,
	};
	static const uint8_t derived_key_ref[FP_FHN_EIK_DERIVED_KEY_MAX_LEN] = {
		0x05, 0x92, 0x9f, 0xbe, 0xc8, 0xcc, 0xd6, 0xe5,
		0x10, 0x24, 0xc6, 0x40, 0x97, 0x45, 0x2d, 0xaf,
		0x23, 0xa2, 0x38, 0x43, 0xd8, 0x88, 0x4c, 0x5a,
		0xe1, 0x40, 0x87, 0xbe, 0x48, 0x5c, 0x8c, 0x6d,
	};
	static const uint8_t seed_end_byte = 0x02;

	uint8_t derived_key[FP_FHN_EIK_DERIVED_KEY_MAX_LEN];

	zassert_ok(fp_fhn_eik_provision_encrypted(encrypted_eik, account_key));
	zassert_ok(fp_fhn_eik_derive_key(seed_end_byte, derived_key, sizeof(derived_key)));
	zassert_mem_equal(derived_key, derived_key_ref, sizeof(derived_key_ref),
			  "Invalid ring derived key");
}

ZTEST(eik_suite, test_derive_keys_utp)
{
	static const uint8_t account_key[FP_FHN_ACCOUNT_KEY_LEN] = {
		0x01, 0x23, 0x45, 0x67, 0x89, 0xab, 0xcd, 0xef,
		0x01, 0x23, 0x45, 0x67, 0x89, 0xab, 0xcd, 0xef,
	};
	static const uint8_t encrypted_eik[FP_FHN_ENCRYPTED_EIK_LEN] = {
		0xa1, 0xee, 0x56, 0x08, 0xb3, 0x3a, 0xf0, 0x54,
		0x70, 0x85, 0x86, 0x08, 0xd1, 0xde, 0x08, 0x0f,
		0xa1, 0xee, 0x56, 0x08, 0xb3, 0x3a, 0xf0, 0x54,
		0x70, 0x85, 0x86, 0x08, 0xd1, 0xde, 0x08, 0x0f,
	};
	static const uint8_t derived_key_ref[FP_FHN_EIK_DERIVED_KEY_MAX_LEN] = {
		0x4c, 0x31, 0x85, 0x05, 0xc1, 0xf2, 0x3e, 0xaf,
		0xc9, 0xe1, 0xcf, 0x12, 0xde, 0xd4, 0xab, 0x89,
		0x76, 0x78, 0xe0, 0x4f, 0x63, 0x04, 0x41, 0xb7,
		0xe1, 0xfb, 0xa3, 0x2b, 0xfc, 0x84, 0x1b, 0x29,
	};
	static const uint8_t seed_end_byte = 0x03;

	uint8_t derived_key[FP_FHN_EIK_DERIVED_KEY_MAX_LEN];

	zassert_ok(fp_fhn_eik_provision_encrypted(encrypted_eik, account_key));
	zassert_ok(fp_fhn_eik_derive_key(seed_end_byte, derived_key, sizeof(derived_key)));
	zassert_mem_equal(derived_key, derived_key_ref, sizeof(derived_key_ref),
			  "Invalid UTP derived key");
}

ZTEST_SUITE(eik_suite, NULL, NULL, eik_before, eik_after, NULL);
```
