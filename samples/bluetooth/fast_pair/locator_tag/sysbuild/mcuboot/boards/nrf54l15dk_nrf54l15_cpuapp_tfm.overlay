/*
 * Copyright (c) 2024-2026 Nordic Semiconductor ASA
 *
 * SPDX-License-Identifier: LicenseRef-Nordic-5-Clause
 */

#include "../../../configuration/boards/nrf54l15dk_nrf54l15_cpuapp_ns.overlay"

/ {
	chosen {
		zephyr,code-partition = &boot_partition;
	};
};
