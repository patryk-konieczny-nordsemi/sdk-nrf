## tests/subsys/bluetooth/fast_pair/eik_operations/testcase.yaml
```yaml
common:
  tags:
    - sysbuild
    - bluetooth
    - ci_tests_subsys_bluetooth_fast_pair
tests:
  fast_pair.fhn_eik.default:
    sysbuild: true
    platform_allow:
      - nrf52dk/nrf52832
      - nrf52840dk/nrf52840
      - nrf5340dk/nrf5340/cpuapp
      - nrf54l15dk/nrf54l05/cpuapp
      - nrf54l15dk/nrf54l10/cpuapp
      - nrf54l15dk/nrf54l15/cpuapp
      - nrf54l15dk/nrf54l15/cpuapp/ns
      - nrf54lm20dk/nrf54lm20a/cpuapp
      - nrf54lm20dk/nrf54lm20b/cpuapp
      - nrf54ls05dk/nrf54ls05b/cpuapp
    integration_platforms:
      - nrf52dk/nrf52832
      - nrf5340dk/nrf5340/cpuapp
      - nrf54l15dk/nrf54l05/cpuapp
      - nrf54l15dk/nrf54l15/cpuapp/ns
      - nrf54lm20dk/nrf54lm20a/cpuapp
      - nrf54lm20dk/nrf54lm20b/cpuapp
      - nrf54ls05dk/nrf54ls05b/cpuapp
  fast_pair.fhn_eik.spe:
    sysbuild: true
    platform_allow:
      - nrf54l15dk/nrf54l15/cpuapp/ns
    integration_platforms:
      - nrf54l15dk/nrf54l15/cpuapp/ns
    extra_args: FILE_SUFFIX=spe
```

## tests/subsys/bluetooth/fast_pair/provisioner/testcase.yaml
```yaml
common:
  sysbuild: true
  tags:
    - sysbuild
    - bluetooth
    - pytest
    - ci_tests_subsys_bluetooth_fast_pair
  platform_allow:
    - nrf54l15dk/nrf54l15/cpuapp/ns
  integration_platforms:
    - nrf54l15dk/nrf54l15/cpuapp/ns
tests:
  fast_pair.provisioner.image:
    build_only: true
    extra_args:
      - FILE_SUFFIX=provisioner
  fast_pair.provisioner.app_post_prov:
    build_only: true
    extra_args:
      - FILE_SUFFIX=post_prov
  fast_pair.provisioner.flow:
    harness: pytest
    timeout: 600
    required_applications:
      - name: fast_pair.provisioner.image
      - name: fast_pair.provisioner.app_post_prov
    harness_config:
      pytest_root:
        - "pytest/test_provisioner_flow.py"
```
