## samples/bluetooth/fast_pair/input_device/boards/nrf54l15dk_nrf54l15_cpuapp_ns_provisioner.conf
```kconfig
#
# Copyright (c) 2026 Nordic Semiconductor ASA
#
# SPDX-License-Identifier: LicenseRef-Nordic-5-Clause
#

CONFIG_SYSTEM_WORKQUEUE_STACK_SIZE=3584

# Configure TF-M verbosity
CONFIG_TFM_LOG_LEVEL_SILENCE=n
CONFIG_TFM_SPM_LOG_LEVEL_DEBUG=y
CONFIG_TFM_EXCEPTION_INFO_DUMP=y
```

## samples/bluetooth/fast_pair/locator_tag/configuration/boards/nrf54l15dk_nrf54l15_cpuapp_ns_tfm_provisioner.conf
```kconfig
#
# Copyright (c) 2026 Nordic Semiconductor ASA
#
# SPDX-License-Identifier: LicenseRef-Nordic-5-Clause
#

CONFIG_SYSTEM_WORKQUEUE_STACK_SIZE=3584

# Enable code partitioning with DTS
CONFIG_USE_DT_CODE_PARTITION=y

# Disable application ranging module
CONFIG_APP_RANGING=n

# Configure TF-M verbosity
CONFIG_TFM_LOG_LEVEL_SILENCE=n
CONFIG_TFM_SPM_LOG_LEVEL_INFO=y
CONFIG_TFM_EXCEPTION_INFO_DUMP=y

# Disable Protected Storage
CONFIG_TFM_PARTITION_PROTECTED_STORAGE=n

# Configure CUSTOM crypto backend
CONFIG_BT_FAST_PAIR_CRYPTO_CUSTOM=y
```

## subsys/bluetooth/fast_pair/Kconfig.credentials
```kconfig
#
# Copyright (c) 2026 Nordic Semiconductor ASA
#
# SPDX-License-Identifier: LicenseRef-Nordic-5-Clause
#

menu "Fast Pair credentials (KMU / ITS)"

config BT_FAST_PAIR_ANTI_SPOOFING_PRIVATE_KEY_KMU_SLOT
	int "CRACEN KMU slot for the Anti-Spoofing private key"
	range 0 178
	default 30
	help
	  KMU slot index (RAW usage scheme) for the 256-bit Anti-Spoofing key.
	  Must match on provisioner and application images.

	  When building with sysbuild, this config cannot be set manually.
	  The value is overwritten by sysbuild Kconfig.

config BT_FAST_PAIR_MODEL_ID_ITS_ID
	hex "PSA Internal Trusted Storage UID for the Model ID"
	range 0x1 0xFFFEFFFF
	default 0x30000
	help
	  PSA ITS uid for the 24-bit Fast Pair Model ID.
	  Must match on provisioner and application images.

	  When building with sysbuild, this config cannot be set manually.
	  The value is overwritten by sysbuild Kconfig.

if BT_FAST_PAIR_RUNTIME_PROVISIONER

config BT_FAST_PAIR_MODEL_ID
	hex "Fast Pair Model ID"
	range 0x000000 0x1000000
	default 0x1000000
	help
	  24-bit Model ID (0x000000–0xFFFFFF). Embedded in the runtime
	  provisioner image and written to ITS at provisioning time.

	  When building with sysbuild, this config cannot be set manually.
	  The value is overwritten by sysbuild Kconfig.

config BT_FAST_PAIR_ANTI_SPOOFING_PRIVATE_KEY
	string "Anti-Spoofing Private Key (base64)"
	default ""
	help
	  Base64-encoded Anti-Spoofing private key for the runtime provisioner.
	  Confidential. Decoded at build time; not decoded on device.

	  When building with sysbuild, this config cannot be set manually.
	  The value is overwritten by sysbuild Kconfig.

endif # BT_FAST_PAIR_RUNTIME_PROVISIONER

endmenu
```

## subsys/bluetooth/fast_pair/fhn/Kconfig.eik
```kconfig
#
# Copyright (c) 2026 Nordic Semiconductor ASA
#
# SPDX-License-Identifier: LicenseRef-Nordic-5-Clause
#

menu "FHN Ephemeral Identity Key (EIK)"

config BT_FAST_PAIR_FHN_EIK
	bool
	default y
	depends on BT_FAST_PAIR_FHN_CRYPTO
	help
	  Enable FHN Ephemeral Identity Key (EIK) operations.

config BT_FAST_PAIR_FHN_EIK_SPE
	bool
	default y
	depends on BUILD_WITH_TFM
	depends on TFM_IPC
	depends on TFM_PARTITION_INTERNAL_TRUSTED_STORAGE
	depends on TFM_PARTITION_CRYPTO
	depends on BT_FAST_PAIR_FHN_EIK
	help
	  Store the Ephemeral Identity Key (EIK) in the TF-M secure partition (ITS).
	  Automatically enabled on TF-M builds that satisfy the dependencies.

config BT_FAST_PAIR_FHN_EIK_ITS_ID
	hex "PSA Internal Trusted Storage UID for the Ephemeral identity key"
	depends on BT_FAST_PAIR_FHN_EIK_SPE
	range 0x1 0xFFFEFFFF
	default 0x30001
	help
	  PSA ITS UID for the 32-byte FHN Ephemeral Identity Key (EIK).

if BT_FAST_PAIR_FHN_EIK_SPE

choice BT_FAST_PAIR_FHN_EIK_SPE_LOG_LEVEL_CHOICE
	default BT_FAST_PAIR_FHN_EIK_SPE_LOG_LEVEL_OFF if TFM_LOG_LEVEL_SILENCE
	help
	  Compile-time log level of the EIK secure partition.
	  It applies to every source built into that partition, including the
	  secure copy of the Fast Pair crypto backend. The non-secure build of
	  shared sources keeps using its own Zephyr log level.
	  The Default option uses the TF-M partition log level.
endchoice

module = BT_FAST_PAIR_FHN_EIK_SPE
module-str = EIK secure partition
source "$(ZEPHYR_BASE)/subsys/logging/Kconfig.template.log_config"

endif # BT_FAST_PAIR_FHN_EIK_SPE

endmenu
```

## subsys/bluetooth/fast_pair/fhn/Kconfig.fhn_crypto
```kconfig
#
# Copyright (c) 2026 Nordic Semiconductor ASA
#
# SPDX-License-Identifier: LicenseRef-Nordic-5-Clause
#

menu "FHN crypto"

choice BT_FAST_PAIR_FHN_ECC_TYPE
	prompt "Elliptic Curve selection"
	default BT_FAST_PAIR_FHN_ECC_SECP160R1
	help
	  Select the elliptic curve used for FHN Ephemeral Identifier (EID)
	  encoding and related cryptographic operations across FHN modules.

config BT_FAST_PAIR_FHN_ECC_SECP160R1
	bool "FHN with the SECP160R1 Elliptic Curve"
	depends on BT_FAST_PAIR_CRYPTO_SECP160R1_SUPPORT
	help
	  Select the SECP160R1 elliptic curve. This curve type is less secure
	  than the SECP256R1 variant, but it can be used with Bluetooth Legacy
	  Advertising because of its limited size (160 bits).

config BT_FAST_PAIR_FHN_ECC_SECP256R1
	bool "FHN with the SECP256R1 Elliptic Curve"
	depends on BT_FAST_PAIR_CRYPTO_SECP256R1_SUPPORT
	help
	  Select the SECP256R1 elliptic curve. This curve type is more secure
	  than the SECP160R1 variant but requires Bluetooth Extended Advertising
	  due to its extended size (256 bits).

endchoice

config BT_FAST_PAIR_FHN_ECC_LEN
	int
	depends on BT_FAST_PAIR_FHN_ECC_SECP160R1 || BT_FAST_PAIR_FHN_ECC_SECP256R1
	default 20 if BT_FAST_PAIR_FHN_ECC_SECP160R1
	default 32 if BT_FAST_PAIR_FHN_ECC_SECP256R1
	help
	  Byte length of the chosen elliptic curve (EID length in FHN frames).

config BT_FAST_PAIR_FHN_CRYPTO
	bool
	default y
	depends on BT_FAST_PAIR_CRYPTO_AES256_ECB_SUPPORT
	depends on BT_FAST_PAIR_FHN_ECC_SECP160R1 || BT_FAST_PAIR_FHN_ECC_SECP256R1
	help
	  Enable FHN use of Fast Pair crypto (AES-256-ECB and ECC). Selected
	  automatically by BT_FAST_PAIR_FHN when the full extension is enabled.

config BT_FAST_PAIR_FHN_RANDOM_NONCE_LEN
	int "Random nonce length for Beacon Actions [bytes]"
	default 8
	help
	  Byte length of the random nonce used in Beacon Actions authentication
	  and EIK hash comparison.

endmenu
```

## subsys/bluetooth/fast_pair/fp_provision/Kconfig.fp_provision
```kconfig
#
# Copyright (c) 2026 Nordic Semiconductor ASA
#
# SPDX-License-Identifier: LicenseRef-Nordic-5-Clause
#

menuconfig FP_PROVISION_DATA
	bool "Fast Pair provisioning registration"
	depends on PROVISIONER
	select PSA_WANT_KEY_TYPE_ECC_KEY_PAIR_IMPORT
	select PSA_WANT_ECC_SECP_R1_256
	select PSA_WANT_ALG_ECDH
	help
	  Link Fast Pair KMU/ITS registration entries into the provisioner.
	  Does not enable the Fast Pair Bluetooth stack.

if FP_PROVISION_DATA

rsource "../Kconfig.credentials"

endif # FP_PROVISION_DATA
```

## sysbuild/Kconfig.bt_fast_pair
```kconfig
#
# Copyright (c) 2023-2026 Nordic Semiconductor
#
# SPDX-License-Identifier: LicenseRef-Nordic-5-Clause
#

menu "Bluetooth Fast Pair"

choice BT_FAST_PAIR_PROVISION_SOURCE
	prompt "Fast Pair provisioning pipeline"
	default BT_FAST_PAIR_PROVISION_PARTITION
	help
	  Select how Fast Pair credentials (Model ID and Anti-Spoofing private key)
	  are placed on the device during the build and provisioning flow.

	  This is a sysbuild-level choice. It controls the build pipeline and which
	  application Kconfig options are forwarded to the default image via
	  sysbuild. It does not replace the corresponding choice in the application
	  Fast Pair Kconfig tree.

	config BT_FAST_PAIR_PROVISION_PARTITION
		bool "Flash partition (build-time hex merge)"
		help
		  Generate a Fast Pair provisioning hex file at build time and merge it
		  into the bt_fast_pair flash partition in the final image.

		  Use this on targets that define a bt_fast_pair partition (Partition
		  Manager or devicetree). Sysbuild generates the hex when Model ID and
		  Anti-Spoofing key are set (see SB_CONFIG_BT_FAST_PAIR_PROV_DATA).

		  Typical for single-image builds on nRF52/nRF53/nRF54 without TF-M /ns.
		  Not used on /ns (TF-M) secure-storage flows.

	config BT_FAST_PAIR_PROVISION_SECURE_STORAGE
		bool "KMU and Internal Trusted Storage (runtime provisioner)"
		help
		  Store credentials in hardware-protected storage instead of a flash
		  partition:
		  	- Anti-Spoofing private key in a CRACEN KMU slot
		  	(SB_CONFIG_BT_FAST_PAIR_ANTI_SPOOFING_PRIVATE_KEY_KMU_SLOT)
		  	- Model ID in PSA Internal Trusted Storage
		  	(SB_CONFIG_BT_FAST_PAIR_MODEL_ID_ITS_ID)

		  Requires a runtime provisioner image
		  (SB_CONFIG_BT_FAST_PAIR_RUNTIME_PROVISIONER) to write credentials
		  before the main application runs. The main application then reads
		  from KMU/ITS at runtime.

		  Intended for non-secure (TF-M) builds. Slot and ITS UID values must
		  match on provisioner and application images; sysbuild forwards them
		  to both via the Kconfig bridge.

endchoice

config BT_FAST_PAIR_RUNTIME_PROVISIONER
	bool "Build runtime provisioner image"
	default n
	depends on BT_FAST_PAIR_PROVISION_SECURE_STORAGE
	help
	  Build a provisioner application image that writes Fast Pair credentials
	  into KMU and Internal Trusted Storage at first boot (or when flashed).  
	  Enable together with BT_FAST_PAIR_PROVISION_SECURE_STORAGE. Use a
	  provisioner FILE_SUFFIX (for example mcuboot_provisioner or
	  provisioner) so sysbuild builds the writer image before the main app.

	  The provisioner registers SB_CONFIG_BT_FAST_PAIR_MODEL_ID and
	  SB_CONFIG_BT_FAST_PAIR_ANTI_SPOOFING_PRIVATE_KEY using the KMU slot and
	  ITS UID configured in this menu. Flash the provisioner image first
	  (preferably with --erase/--recover flag to clear old data), then the
	  main Fast Pair application.

config BT_FAST_PAIR_MODEL_ID
	hex "Set the Model ID used for Fast Pair provisioning"
	range 0x000000 0x1000000
	default 0x1000000
	help
	  Set the Model ID that is used to generate the Fast Pair provisioning data hex file.
	  The Model ID is obtained during device model registration in the Google Nearby Console.
	  Note that the corresponding SB_CONFIG_BT_FAST_PAIR_ANTI_SPOOFING_PRIVATE_KEY Kconfig
	  option must be supplied to trigger the generation of the Fast Pair provisioning data hex
	  file. The generation is indicated by the SB_CONFIG_BT_FAST_PAIR_PROV_DATA Kconfig.

	  The Model ID should be a value from the 0x000000 - 0xFFFFFF range. The additional
	  default value (0x1000000) that is outside of the actual range is only used to mark
	  this option as unset by the user.

config BT_FAST_PAIR_ANTI_SPOOFING_PRIVATE_KEY
	string "Set the Anti-Spoofing Private Key used for Fast Pair provisioning"
	help
	  Set the Anti-Spoofing Private Key that is used to generate the Fast Pair provisioning
	  data hex file. The Anti-Spoofing Private Key is obtained during device model registration
	  in the Google Nearby Console. Note that the corresponding SB_CONFIG_BT_FAST_PAIR_MODEL_ID
	  Kconfig option must be supplied to trigger the generation of the Fast Pair provisioning
	  data hex file The generation is indicated by the SB_CONFIG_BT_FAST_PAIR_PROV_DATA
	  Kconfig.

	  The Anti-Spoofing Private Key is confidential and must be handled securely. It is
	  recommended to store this key securely outside the code repository and pass it to
	  the project as an additional argument for the build command
	  (``-DSB_CONFIG_BT_FAST_PAIR_ANTI_SPOOFING_PRIVATE_KEY=<value>``).

config BT_FAST_PAIR_ANTI_SPOOFING_PRIVATE_KEY_KMU_SLOT
	int "CRACEN KMU slot for the Anti-Spoofing private key"
	default 30
	help
	  KMU slot index (RAW usage scheme) for the Anti-Spoofing Private Key
	  when BT_FAST_PAIR_PROVISION_SECURE_STORAGE is selected. The runtime provisioner
	  image imports the key from SB_CONFIG_BT_FAST_PAIR_ANTI_SPOOFING_PRIVATE_KEY
	  into this slot; the main Fast Pair application reads it from KMU at
	  runtime instead of the bt_fast_pair flash partition. Must match on
	  provisioner and application images (sysbuild forwards this value to both).

config BT_FAST_PAIR_MODEL_ID_ITS_ID
	int "PSA Internal Trusted Storage UID for the Model ID"
	default 2000
	help
	  PSA ITS uid for the 24-bit Model ID when BT_FAST_PAIR_PROVISION_SECURE_STORAGE is
	  selected. The runtime provisioner image writes SB_CONFIG_BT_FAST_PAIR_MODEL_ID
	  here; the main Fast Pair application reads it from ITS at runtime instead
	  of the bt_fast_pair flash partition. Must match on provisioner and
	  application images (sysbuild forwards this value to both).


config BT_FAST_PAIR_PROV_DATA
	bool
	depends on BT_FAST_PAIR_PROVISION_PARTITION
	depends on BT_FAST_PAIR_MODEL_ID != 0x1000000
	depends on BT_FAST_PAIR_ANTI_SPOOFING_PRIVATE_KEY != ""
	default y
	help
	  This option is automatically enabled when partition-based provisioning
	  (SB_CONFIG_BT_FAST_PAIR_PROVISION_PARTITION) is selected and both the Model ID
	  (SB_CONFIG_BT_FAST_PAIR_MODEL_ID) and the Anti-Spoofing Private Key
	  (SB_CONFIG_BT_FAST_PAIR_ANTI_SPOOFING_PRIVATE_KEY) are set.

	  When this option is enabled, sysbuild generates the Fast Pair provisioning data hex file
	  and merges it with the final output hex file that is uploaded on the chosen board target.

	  For the generation step to work correctly, the user must manually define the Fast Pair
	  partition. In the case of platforms that use the DTS for memory map description (for
	  example, nRF54H), the Fast Pair partition must be defined as a DTS node. In the case of
	  platforms that use the Partition Manager (PM) for memory map description (for example,
	  nRF54L), the Fast Pair partition must be a statically defined PM partition. The PM
	  solution also supports the dynamic generation of the partition definition if the
	  CONFIG_BT_FAST_PAIR Kconfig is enabled in the main (default) image. This is the only case
	  when the partition does not have to be manually defined by the user. Detailed
	  documentation regarding the Fast Pair partition definition can be found in the Fast Pair
	  integration guide.
endmenu
```

## tests/subsys/bluetooth/fast_pair/crypto/Kconfig
```kconfig
#
# Copyright (c) 2022-2026 Nordic Semiconductor
#
# SPDX-License-Identifier: LicenseRef-Nordic-5-Clause
#

choice TEST_BT_FAST_PAIR_CRYPTO_BACKEND
	prompt "Fast Pair crypto test backend"
	optional
	help
	  Select the cryptographic backend configuration used by the test.
	  Leave unset to use the Oberon backend from prj.conf.

config TEST_BT_FAST_PAIR_CRYPTO_PSA
	bool "Enable PSA backend and dependencies"
	help
	  Enable the PSA cryptographic backend for the test and pull in
	  related dependencies. Used to avoid board-specific Kconfig overlays.

config TEST_BT_FAST_PAIR_CRYPTO_CUSTOM
	bool "Enable custom backend and dependencies"
	help
	  Enable the custom (TFM + Oberon) cryptographic backend for the test and
	  pull in related dependencies. Used to avoid board-specific Kconfig overlays.

endchoice

if TEST_BT_FAST_PAIR_CRYPTO_PSA

choice BT_FAST_PAIR_CRYPTO_BACKEND
	default BT_FAST_PAIR_CRYPTO_PSA
endchoice

endif # TEST_BT_FAST_PAIR_CRYPTO_PSA

if TEST_BT_FAST_PAIR_CRYPTO_CUSTOM

choice BT_FAST_PAIR_CRYPTO_BACKEND
	default BT_FAST_PAIR_CRYPTO_CUSTOM
endchoice

endif # TEST_BT_FAST_PAIR_CRYPTO_CUSTOM

menu "Test configuration"
source "$(ZEPHYR_NRF_MODULE_DIR)/subsys/bluetooth/fast_pair/fp_crypto/Kconfig.fp_crypto"
endmenu

menu "Zephyr"
source "Kconfig.zephyr"
endmenu
```
